## build/Kconfig/Kconfig.shield
```kconfig
osource "c:/projects/nrf/nrf-mesh-chat/boards/shields/*/Kconfig.shield"
osource "C:/ncs/v2.6.1/nrf/boards/shields/*/Kconfig.shield"
```

## build/Kconfig/Kconfig.shield.defconfig
```kconfig
osource "c:/projects/nrf/ble-mesh-tracker/boards/shields/*/Kconfig.defconfig"
osource "C:/ncs/v2.6.1/nrf/boards/shields/*/Kconfig.defconfig"
```

## nrf-ble-tracker/build_52833/Kconfig/Kconfig.shield
```kconfig
osource "f:/projects/ble-mesh-tracker/nrf-ble-tracker/boards/shields/*/Kconfig.shield"
osource "C:/ncs/v2.6.1/nrf/boards/shields/*/Kconfig.shield"
```

## nrf-ble-tracker/build_high_mem_slave/Kconfig/Kconfig.shield.defconfig
```kconfig
osource "c:/projects/ble-mesh-tracker/nrf-ble-tracker/boards/shields/*/Kconfig.defconfig"
osource "C:/ncs/v2.6.1/nrf/boards/shields/*/Kconfig.defconfig"
```

## nrf52833_build/Kconfig/Kconfig.shield
```kconfig
osource "c:/projects/nrf/ble-mesh-tracker/boards/shields/*/Kconfig.shield"
osource "C:/ncs/v2.6.1/nrf/boards/shields/*/Kconfig.shield"
```
